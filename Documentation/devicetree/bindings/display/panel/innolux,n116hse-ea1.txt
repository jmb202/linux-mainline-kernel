## Documentation/devicetree/bindings/display/panel/innolux,n116hse-ea1.txt
```
Innolux Corporation 11.6" FHD (1920x1080) TFT LCD panel

Required properties:
- compatible: should be "innolux,n116hse-ea1"

This binding is compatible with the simple-panel binding, which is specified
in simple-panel.txt in this directory.
```
